/* Copyright (c) 2020 Linaro Limited.
 * SPDX-License-Identifier: Apache-2.0
 */

pmod_spi: &spi1 {
};

&pmod_spi {
	status = "okay";
	cs-gpios = <&arduino_header 16 GPIO_ACTIVE_LOW>;	/* D10 */

	enc424j600@0 {
		status = "okay";
		compatible = "microchip,enc424j600";
		reg = <0>;
		spi-max-frequency = <14000000>;
		int-gpios = <&arduino_header 15 GPIO_ACTIVE_LOW>;	/* D9 */
		label = "ETH_0";
	};
};

