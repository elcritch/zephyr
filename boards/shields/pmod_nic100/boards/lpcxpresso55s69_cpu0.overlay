/*
 * Copyright (C) 2020, NXP
 *
 * SPDX-License-Identifier: Apache-2.0
 */

/delete-node/ &eth_click;

// &flexcomm3 {
// 	compatible = "nxp,lpc-spi";
// };

pmod_spi: &flexcomm3 {
	status = "okay";
	compatible = "nxp,lpc-spi";
};

&pmod_spi {
	status = "okay";
	cs-gpios = <&arduino_header 16 GPIO_ACTIVE_LOW>;	/* D10 */

	enc424j600@0 {
		status = "okay";
		compatible = "microchip,enc424j600";
		reg = <0>;
		spi-max-frequency = <14000000>;
		int-gpios = <&gpio1 28 GPIO_ACTIVE_LOW>;	/* PIO1_28 => PLU_IN3  */
		label = "ETH_0";
	};
};

