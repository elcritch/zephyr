/*
 * Copyright (C) 2020, NXP
 *
 * SPDX-License-Identifier: Apache-2.0
 */

&mikrobus_spi {
	status = "okay";
	cs-gpios = <&mikrobus_header 2 GPIO_ACTIVE_LOW>;	/* A5 */

	enc424j600@0 {
		status = "okay";
		compatible = "microchip,enc424j600";
		reg = <0>;
		spi-max-frequency = <20000000>;
		int-gpios = <&mikrobus_header 7 GPIO_ACTIVE_LOW>;	/* PIO1_28 => PLU_IN3  */
		label = "ETH_0";
	};
};

