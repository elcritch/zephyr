## boards/shields/mikroe_feather_click/Kconfig.shield
```kconfig
# Copyright (c) 2020 Linaro Limited.
# SPDX-License-Identifier: Apache-2.0

config SHIELD_MIKROE_FEATHER_CLICK
	def_bool $(shields_list_contains,mikroe_feather_click)
```

## boards/shields/pmod_nic100/Kconfig.defconfig
```kconfig
# Copyright (c) 2020 Linaro Limited
# SPDX-License-Identifier: Apache-2.0

if SHIELD_PMOD_NIC100

if NETWORKING

config SPI
	default y

config NET_L2_ETHERNET
	default y

# ENC28J60 Ethernet Device
config ETH_ENC424J600
	default y

endif # NETWORKING

endif # SHIELD_MIKROE_ETH_CLICK
```

## boards/shields/pmod_nic100/Kconfig.shield
```kconfig
# Copyright (c) 2020 Linaro Limited.
# SPDX-License-Identifier: Apache-2.0

config SHIELD_PMOD_NIC100
	def_bool $(shields_list_contains,pmod_nic100)
```

## modules/external-tracing/Kconfig
```kconfig
# Zephyr module config for external tracing.
# The real Kconfig for the module is located externally,
# this file is to ensure ZEPHYR_EXTERNALTRACING_MODULE is defined also when the
# module is unavailable.

# SPDX-License-Identifier: Apache-2.0

config ZEPHYR_EXTERNALTRACING_MODULE
    bool
```
